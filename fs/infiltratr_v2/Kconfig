## fs/infiltratr_v2/Kconfig
```kconfig
# SPDX-License-Identifier: GPL-2.0-only
config INFILTRATR_V2_FS
    tristate "InfiltratorOS Common V2 generic read-only filesystem adapter"
    depends on BLOCK && X86_64
    select SYSTEM_DATA_VERIFICATION
    default n
    help
      Create a format-neutral Linux VFS adapter for independently owned
      Common V2 filesystem shared objects. This is NOT a per-format Linux
      filesystem driver, and does not use FUSE.

      Admission requires a detached PKCS#7 signature over the complete
      installed shared-object carrier and validates its embedded freestanding
      ELF. The executor remains fail-closed: no mount will succeed until the
      W^X executor and authenticated root qualification have passed.
      Keep it disabled on production systems until then.
```
